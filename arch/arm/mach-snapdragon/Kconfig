## arch/arm/mach-snapdragon/Kconfig
```kconfig
if ARCH_SNAPDRAGON

config SYS_SOC
	default "snapdragon"

config SYS_VENDOR
	string "Snapdragon board vendor"
	default "qualcomm"
	help
	  Allows to specify vendor for the Snapdragon SoCs based boards.
	  Based on this option board/<CONFIG_SYS_VENDOR>/<CONFIG_SYS_BOARD>
	  will be used as the custom board directory.

config SYS_MALLOC_LEN
	default 0x10000000

config SYS_MALLOC_F_LEN
	default 0x2000

config SPL_SYS_MALLOC_F_LEN
	default 0x2000

config SYS_MALLOC_LEN
	default 0x800000

config LNX_KRNL_IMG_TEXT_OFFSET_BASE
	default 0x80000000

config SYS_BOARD
	string "Snapdragon SoCs based board"
	help
	  Allows to specify the Snapdragon SoCs based board name.
	  Based on this option board/<CONFIG_SYS_VENDOR>/<CONFIG_SYS_BOARD>
	  will be used as the custom board directory.

config SYS_CONFIG_NAME
	string "Board configuration name"
	default SYS_BOARD if SYS_BOARD != ""
	default "qcom"
	help
	  This option contains information about board configuration name.
	  Based on this option include/configs/<CONFIG_SYS_CONFIG_NAME>.h header
	  will be used for board configuration.

config QCOM_PMI632_CHARGE
	bool "Keep a PMI632 charging and show the charger state"
	depends on PMIC_QCOM && CYCLIC
	help
	  Pet the PMI632 charger watchdog while U-Boot runs, so that charging
	  does not stop after two minutes in the menu, let a wall charger
	  draw 1.5 A, and draw a battery symbol in the top right corner of
	  the screen while a charger is plugged in.

endif
```
